;
; BLACKEYES 601 ZERO
; Devices mapping
;

; SimpleIO module

IO_L7HI		equ	$E6A1
IO_L7LO		equ	$E6A2
IO_LRGB		equ	$E6A3

IO_TIM_CONFIG	equ	$E6A8
IO_TIM_STATUS	equ	$E6A8
IO_TIM_DIV	equ	$E6A9

IO_TIM_RUN	equ	$1
IO_TIM_IEN	equ	$40
IO_TIM_IRQ	equ	$80

; UART module

UART_DATA	equ	$E6B0
UART_CONFIG	equ	$E6B1
UART_STATUS	equ	$E6B1
UART_PRESCALER	equ	$E6B2

UART_RRD	equ	$1
UART_ROE	equ	$2
UART_RFE	equ	$4
UART_TRD	equ	$8
UART_RIE	equ	$10
UART_TIE	equ	$20
UART_RIQ	equ	$40
UART_TIQ	equ	$80

PS2_DATA	equ	$E6B4
PS2_CONFIG	equ	$E6B5
PS2_STATUS	equ	$E6B5

PS2_KRD		equ	$01
PS2_KPR		equ	$02
PS2_KIE		equ	$40
PS2_KIQ		equ	$80

; SPI HOST
SDSPI_STATUS	equ	$E6C0
SDSPI_CONFIG	equ	$E6C0
SDSPI_DATA	equ	$E6C1
SDSPI_PRESCALER	equ	$E6C2

SDSPI_READY	equ	$80
SDSPI_SEL	equ	$01

; PAGE SELECTOR
RAMPAGE_SEL	equ	$E6F0
RAMPAGE_CTL	equ	$E6F1
RAMPAGE_LOCK	equ	$01
SYSBOOT_LOCK	equ	$02
BRAM_DISABLE	equ	$04
BROM_DISABLE	equ	$08

;VPU
VPU_HSTART	equ	$E600
VPU_CFG 	equ	$E601
VPU_STAT	equ	$E601
VPU_VSTART	equ	$E602
VPU_VEND	equ	$E604
VPU_VADDR	equ	$E606
VPU_HSIZE	equ	$E608
VPU_CPOS	equ	$E609
VPU_CSTART	equ	$E60A
VPU_CEND	equ	$E60C

VPU_SVL		equ	$01
VPU_EVL		equ	$02
VPU_CIN		equ	$04
VPU_CEN		equ	$08
VPU_GRF		equ	$20
VPU_IEN		equ	$40
VPU_IRQ		equ	$80
